#include <core2.h>

#if !defined(CORE2_DISABLE_OLED)
#include <Adafruit_GFX.h>
#include <Adafruit_SSD1306.h>
#endif

#define SCREEN_WIDTH 128
#define SCREEN_HEIGHT 64
#define DISP_MEM_LEN ((SCREEN_WIDTH * SCREEN_HEIGHT) / 8)
#define DISP_MEM_STRIDE (sizeof(disp_mem) / SCREEN_HEIGHT)

#define FONT_W 5
#define FONT_H 8

static const uint8_t digital_font5x7[] PROGMEM = {
    0x00, 0x00, 0x00, 0x00, 0x00, // char ' ' (0x20/32)
    0x00, 0x00, 0x2E, 0x00, 0x00, // char '!' (0x21/33)
    0x06, 0x00, 0x06, 0x00, 0x00, // char '"' (0x22/34)
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    0x08, 0x08, 0x10, 0x10, 0x00, // char '~' (0x7E/126)
};

uint8_t *disp_mem;

#if !defined(CORE2_DISABLE_OLED)
Adafruit_SSD1306 *display;
#else
void *display;
#endif

void c2_disp_convert_xy(int X, int Y, int *Byte, int *Bit)
{
#if defined(CORE2_DISABLE_OLED)
    return;
#endif

    if (display == NULL)
        return;

    uint16_t Idx = Y * SCREEN_WIDTH + X;
    *Byte = Idx / 8;
    *Bit = 7 - (Idx % 8);
}

int c2_disp_mem_get_from(int X, int Y, const uint8_t *src)
{
#if defined(CORE2_DISABLE_OLED)
    return 0;
#endif

    if (display == NULL)
        return 0;

    int Byte = 0;
    int Bit = 0;
    c2_disp_convert_xy(X, Y, &Byte, &Bit);

    if ((src[Byte] >> Bit) & 0x1)
        return 1;

    return 0;
}

void c2_disp_mem_set(int X, int Y, int V)
{
#if defined(CORE2_DISABLE_OLED)
    return;
#endif

    if (display == NULL)
        return;

    int Byte = 0;
    int Bit = 0;
    c2_disp_convert_xy(X, Y, &Byte, &Bit);

    uint8_t DispByte = disp_mem[Byte];

    if (V)
        DispByte |= 1 << Bit;
    else
        DispByte &= ~(1 << Bit);

    disp_mem[Byte] = DispByte;
    // printf("MEMSET %2d, %d = %d, %d\n", X, Y, Byte, Bit);
}

void c2_copy_bits(const uint8_t *src, int src_offset_bits, int count, int dst_x, int dst_y)
{
#if defined(CORE2_DISABLE_OLED)
    return;
#endif

    if (display == NULL)
        return;

    for (size_t i = 0; i < count; i++)
    {
        int Bit = c2_disp_mem_get_from(src_offset_bits + (count - i), 0, src);

        c2_disp_mem_set(dst_x, dst_y + i, Bit);
    }
}

void c2_blit_char(int dst_x, int dst_y, char chr)
{
#if defined(CORE2_DISABLE_OLED)
    return;
#endif

    if (display == NULL)
        return;

    int CharOffset = (chr - 32) * 5;
    int FontW = 5;
    int FontH = 8;

    for (size_t i = 0; i < FontW; i++)
    {
        c2_copy_bits(digital_font5x7, (CharOffset * 8) + FontH * i, FontH, dst_x + i, dst_y);
    }
}

void c2_scroll(int pixels)
{
#if defined(CORE2_DISABLE_OLED)
    return;
#endif

    if (display == NULL)
        return;

    int shift_bytes = 16 * pixels;

    for (size_t i = shift_bytes; i < DISP_MEM_LEN; i++)
    {
        disp_mem[i - shift_bytes] = disp_mem[i];
    }

    for (size_t i = 0; i < shift_bytes; i++)
    {
        disp_mem[DISP_MEM_LEN - i - 1] = 0;
    }
}

void c2_printxy(int dst_x, int dst_y, const char *str)
{
#if defined(CORE2_DISABLE_OLED)
    return;
#endif

    if (display == NULL)
        return;

    size_t len = strlen(str);
    for (size_t i = 0; i < len; i++)
    {
        c2_blit_char(dst_x + i * 5, dst_y, str[i]);
    }
}

void c2_clear()
{
#if defined(CORE2_DISABLE_OLED)
    return;
#endif

    if (display == NULL)
        return;

#if !defined(CORE2_DISABLE_OLED)
    display->clearDisplay();
#endif
}

void c2_display(uint16_t color)
{
#if defined(CORE2_DISABLE_OLED)
    return;
#endif

    if (display == NULL)
        return;

#if !defined(CORE2_DISABLE_OLED)
    display->drawBitmap(0, 0, disp_mem, SCREEN_WIDTH, SCREEN_HEIGHT, color);
    display->display();
#endif
}

void core2_oled_print(const char *txt)
{
#if defined(CORE2_DISABLE_OLED)
    return;
#endif

    dprintf("core2_oled_print: %s\n", txt);

    c2_scroll(FONT_H);
    c2_printxy(0, 7 * FONT_H, txt);

    c2_clear();
    c2_display(1);
}

bool core2_oled_init()
{
#if defined(CORE2_DISABLE_OLED)
    dprintf("core2_oled_init() - SKIPPING, DISABLED\n");
    return false;
#else
    dprintf("core2_oled_init()\n");

    display = new Adafruit_SSD1306(SCREEN_WIDTH, SCREEN_HEIGHT, &Wire, -1);
    Wire.begin(5, 4); // Start I2C Communication SDA = 5 and SCL = 4 on Wemos Lolin32 ESP32 with built-in SSD1306 OLED

    if (!display->begin(SSD1306_SWITCHCAPVCC, 0x3C, false, false))
    {
        dprintf("core2_oled_init() display->begin FAILED\n");
        return false;
    }

    disp_mem = (uint8_t *)malloc(DISP_MEM_LEN);
    memset(disp_mem, 0, DISP_MEM_LEN);

    /*for (size_t i = 0; i < 21; i++)
    {
        c2_disp_mem_set(i, 0, 1);
        c2_disp_mem_set(0, i, 1);
        c2_disp_mem_set(i, 20, 1);
        c2_disp_mem_set(20, i, 1);
    }*/

    core2_oled_print("Hello World!");
    return true;
#endif
}